## main/Kconfig.projbuild
```kconfig
menu "Collar Configuration"

    choice COLLAR_LOG_PROFILE
        prompt "Log Profile"
        default COLLAR_LOG_PROFILE_NORMAL
        help
            Select the default runtime log policy applied at boot.

        config COLLAR_LOG_PROFILE_QUIET
            bool "Quiet"
            help
                Show only high-value lifecycle, warning, and error logs.

        config COLLAR_LOG_PROFILE_NORMAL
            bool "Normal"
            help
                Show major subsystem logs while hiding periodic heartbeat noise.

        config COLLAR_LOG_PROFILE_VERBOSE
            bool "Verbose"
            help
                Enable detailed debug logs for heartbeat and supervisor activity.
    endchoice

    config COLLAR_ENABLE_VERBOSE_BOOT_LOG
        bool "Enable verbose boot trace"
        default y
        help
            Keep the bootstrap log enabled while bringing up the ESP32-C3 real-time
            dialogue controller. Disable it later if you want quieter production logs.

    config COLLAR_CLOUD_PROBE_ENABLE
        bool "Enable cloud reachability probe"
        default y
        help
            Start a lightweight cloud probe service that attempts DNS resolution and
            TCP connectivity checks once Wi-Fi is ready.

    config COLLAR_CLOUD_HOST
        string "Cloud server host"
        default ""
        help
            Hostname or IP address of the cloud endpoint that the ESP should probe.
            Leave empty to keep the cloud probe idle.

    config COLLAR_CLOUD_PORT
        int "Cloud server port"
        range 1 65535
        default 50051
        help
            Target TCP port used by the cloud endpoint. Use your gRPC service port here.

    config COLLAR_CLOUD_PROBE_INTERVAL_SEC
        int "Cloud probe interval (seconds)"
        range 3 300
        default 10
        help
            How often to retry the cloud reachability probe after Wi-Fi becomes ready.

    config COLLAR_CLOUD_CONNECT_TIMEOUT_MS
        int "Cloud connect timeout (ms)"
        range 500 20000
        default 3000
        help
            TCP connect timeout used by the cloud reachability probe.

    menu "Conversation gRPC client (manual h2c + nanopb)"

        config COLLAR_CONV_HOST
            string "Conversation gRPC server host"
            default "traini-grpc-collar-dev-nlb-06c70e7556ee7ab5.elb.us-east-1.amazonaws.com"
            help
                Hostname of the cloud gRPC server (traini.ConversationService).
                Must match the Android client (NLB). Leave empty to keep the
                conversation client idle.

        config COLLAR_CONV_PORT
            int "Conversation gRPC server port"
            range 1 65535
            default 50051
            help
                TCP port of the gRPC server. The current backend is plaintext
                HTTP/2 (h2c) behind an AWS NLB on port 50051, matching the
                Android companion app's usePlaintext() channel.

        config COLLAR_CONV_USER_ID
            string "gRPC user-id metadata header"
            default "CollarOne"
            help
                Value sent in the "user-id" custom HTTP/2 header, matching the
                Android app's GrpcAudioClient.setUserId() value.

        config COLLAR_CONV_AUDIO_BASE64
            bool "Encode AudioChunk.audio_data as base64 string (match Android)"
            default y
            help
                The Android companion encodes the raw PCM bytes as a base64
                ASCII string and puts that into the bytes field. Keep this
                enabled so the server sees identical payloads from both
                clients.


        config COLLAR_CONV_RETRY_INTERVAL_SEC
            int "Reconnect retry interval (seconds)"
            range 3 300
            default 10

        config COLLAR_CONV_AUDIO_SAMPLE_RATE
            int "Uplink audio sample rate"
            range 8000 48000
            default 24000

        config COLLAR_CONV_AUDIO_CHANNELS
            int "Uplink audio channels"
            range 1 2
            default 1

        config COLLAR_CONV_AUDIO_BIT_DEPTH
            int "Uplink audio bit depth"
            range 8 32
            default 16

        config COLLAR_CONV_AUDIO_ENCODING
            string "Uplink AudioFormat encoding string"
            default "pcm16"

        # Conversation sessions are driven exclusively via the UART console
        # commands "ESP:CONV_START" / "ESP:CONV_STOP:<sid>" issued by the
        # nRF companion (see ESP_NRF_SYSTEM_CONTRACT.md). No auto-start,
        # demo loop, or self-test driver is compiled into the firmware.

    endmenu




    config COLLAR_MICROPHONE_ENABLE
        bool "Enable onboard PDM microphone input"
        default y
        help
            Initialize the ESP32-C3 microphone capture path for MP23DB01HPTR.
            On ESP32-C3 this uses SPI master clocking plus software PDM-to-PCM
            decimation instead of the unsupported hardware PDM RX driver.

    config COLLAR_MICROPHONE_LR_HIGH
        bool "Microphone L/R pin strapped HIGH"
        default n
        depends on COLLAR_MICROPHONE_ENABLE
        help
            Set this if the MP23DB01HPTR L/R pin is tied to VDD.
            Low means the microphone drives data on the rising-clock slot and
            this driver samples with SPI mode 0. High selects the falling-clock
            slot and uses SPI mode 1.

    config COLLAR_MICROPHONE_CLK_GPIO
        int "Microphone PDM CLK gpio"
        range 0 21
        default 3
        depends on COLLAR_MICROPHONE_ENABLE
        help
            GPIO driving the shared PDM clock line.

    config COLLAR_MICROPHONE_DIN_GPIO
        int "Microphone PDM DIN gpio"
        range 0 21
        default 4
        depends on COLLAR_MICROPHONE_ENABLE
        help
            GPIO reading the shared PDM data line.

    config COLLAR_MICROPHONE_SAMPLE_RATE
        int "Microphone sample rate"
        range 8000 48000
        default 24000
        depends on COLLAR_MICROPHONE_ENABLE
        help
            PCM sample rate produced by the software PDM decimator.

    config COLLAR_MICROPHONE_STEREO
        bool "Capture both microphone slots"
        default n
        depends on COLLAR_MICROPHONE_ENABLE
        help
            Experimental dual-edge capture for two MP23DB01HPTR microphones on a
            shared CLK/DOUT bus. This mode alternates SPI mode 0/1 at 2x raw PDM
            clock and reconstructs stereo PCM in software. Keep disabled if you
            only need one microphone or if capture stability is more important
            than trying to recover both slots on ESP32-C3.

    config COLLAR_MICROPHONE_TEST_ENABLE
        bool "Enable microphone capture self-test"
        default y
        depends on COLLAR_MICROPHONE_ENABLE
        help
            Periodically read PCM from the microphone input and print amplitude statistics.

    config COLLAR_MICROPHONE_TEST_CHUNK_MS
        int "Microphone test chunk duration (ms)"
        range 10 100
        default 20
        depends on COLLAR_MICROPHONE_TEST_ENABLE
        help
            PCM duration read from the microphone each cycle.

    config COLLAR_MICROPHONE_TEST_LOG_INTERVAL_MS
        int "Microphone test log interval (ms)"
        range 200 5000
        default 1000
        depends on COLLAR_MICROPHONE_TEST_ENABLE
        help
            How often microphone amplitude statistics are printed.

    config COLLAR_MICROPHONE_DENOISE_ENABLE
        bool "Enable SpeexDSP microphone denoise"
        default y
        depends on COLLAR_MICROPHONE_TEST_ENABLE
        help
            Apply SpeexDSP fixed-point preprocess denoise to the PCM blocks read by
            the microphone self-test before they are logged or streamed to the PC.

    config COLLAR_MICROPHONE_DENOISE_FRAME_MS
        int "Denoise frame duration (ms)"
        range 10 20
        default 20
        depends on COLLAR_MICROPHONE_DENOISE_ENABLE
        help
            SpeexDSP preprocess frame size. Keep this at 20 ms on ESP32-C3 unless
            you specifically want to trade more CPU for slightly faster adaptation.

    config COLLAR_MICROPHONE_DENOISE_NOISE_SUPPRESS_DB
        int "Denoise max noise attenuation (dB)"
        range -60 -1
        default -24
        depends on COLLAR_MICROPHONE_DENOISE_ENABLE
        help
            Maximum attenuation applied to stationary noise. More negative values
            remove more noise but also increase the risk of hurting wanted ambience.

    config COLLAR_MICROPHONE_DENOISE_VAD_ENABLE
        bool "Enable SpeexDSP VAD diagnostics"
        default n
        depends on COLLAR_MICROPHONE_DENOISE_ENABLE
        help
            Turn on SpeexDSP VAD and expose speech-block counts in logs. This is
            diagnostic only; the audio is not gated or muted by VAD.

    config COLLAR_MICROPHONE_STREAM_ENABLE
        bool "Stream microphone PCM to PC over UDP"
        default n
        depends on COLLAR_MICROPHONE_TEST_ENABLE
        help
            Mirror the same PCM blocks read by the microphone self-test to a PC over UDP.
            The PC can then write them into a WAV file and optionally play them in real time.

    config COLLAR_MICROPHONE_STREAM_HOST
        string "PC receiver IPv4 address"
        default "192.168.1.2"
        depends on COLLAR_MICROPHONE_STREAM_ENABLE
        help
            IPv4 address of the PC that will receive microphone PCM UDP packets.

    config COLLAR_MICROPHONE_STREAM_PORT
        int "PC receiver UDP port"
        range 1 65535
        default 3333
        depends on COLLAR_MICROPHONE_STREAM_ENABLE
        help
            UDP port on the PC receiver used for live microphone PCM streaming.

    config COLLAR_SPEAKER_ENABLE
        bool "Enable onboard speaker output"
        default y
        help
            Initialize the ESP32-C3 I2S TX path and the MAX98357A SD_MODE control pin.

    config COLLAR_SPEAKER_SD_MODE_GPIO
        int "Speaker amp SD_MODE gpio"
        range 0 21
        default 5
        depends on COLLAR_SPEAKER_ENABLE
        help
            GPIO driving the amplifier SD_MODE pin. Keep it high for playback.

    config COLLAR_SPEAKER_DOUT_GPIO
        int "Speaker I2S DOUT gpio"
        range 0 21
        default 6
        depends on COLLAR_SPEAKER_ENABLE
        help
            GPIO carrying I2S serial audio data into MAX98357A DIN.

    config COLLAR_SPEAKER_BCLK_GPIO
        int "Speaker I2S BCLK gpio"
        range 0 21
        default 7
        depends on COLLAR_SPEAKER_ENABLE
        help
            GPIO carrying I2S bit clock into MAX98357A BCLK.

    config COLLAR_SPEAKER_LRCLK_GPIO
        int "Speaker I2S LRCLK gpio"
        range 0 21
        default 10
        depends on COLLAR_SPEAKER_ENABLE
        help
            GPIO carrying I2S word select into MAX98357A LRCLK.

    config COLLAR_SPEAKER_SAMPLE_RATE
        int "Speaker sample rate"
        range 8000 48000
        default 24000
        depends on COLLAR_SPEAKER_ENABLE
        help
            I2S playback sample rate used for local speaker self-test tones.

    config COLLAR_SPEAKER_TEST_ENABLE
        bool "Enable local speaker tone self-test"
        default n
        depends on COLLAR_SPEAKER_ENABLE
        help
            Continuously play a small loop of fixed-pitch tones through the MAX98357A
            so the speaker path can be validated before cloud downlink is wired in.

    config COLLAR_SPEAKER_TEST_CHUNK_MS
        int "Speaker self-test chunk duration (ms)"
        range 10 100
        default 20
        depends on COLLAR_SPEAKER_TEST_ENABLE
        help
            PCM buffer duration written to I2S each time.

    config COLLAR_SPEAKER_TEST_TONE_MS
        int "Speaker self-test tone duration (ms)"
        range 100 2000
        default 350
        depends on COLLAR_SPEAKER_TEST_ENABLE
        help
            Duration of each audible note in the repeating tone pattern.

    config COLLAR_SPEAKER_TEST_GAP_MS
        int "Speaker self-test gap duration (ms)"
        range 0 1000
        default 120
        depends on COLLAR_SPEAKER_TEST_ENABLE
        help
            Silence inserted between adjacent notes.

    config COLLAR_SPEAKER_TEST_VOLUME_PERCENT
        int "Speaker self-test volume percent"
        range 5 90
        default 35
        depends on COLLAR_SPEAKER_TEST_ENABLE
        help
            Output amplitude scaling for the synthetic tone loop.

endmenu
```
